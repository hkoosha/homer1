## main/Kconfig.projbuild
```kconfig
menu "Homer1 Configuration"

    config MY_WIFI_ENABLED
        bool "WiFi enabled"
        default y
        help
            Whether if wifi is enabled. Affects Prometheus and InfluxDB.

    config MY_WIFI_SSID
        string "WiFi SSID"
        default ""
        help
            Wifi SSID.

    config MY_WIFI_PASSWORD
        string "WiFi password"
        default ""
        help
            Wifi password.

    config MY_INFLUXDB_TOKEN
        string "InfluxDB token"
        default ""
        help
            InfluxDB token.

    config MY_INFLUXDB_URL
        string "InfluxDB URL"
        default ""
        help
            InfluxDB URL. Leave empty to disable.

    config MY_INFLUXDB_ORG
        string "InfluxDB org"
        default "homer1"
        help
            InfluxDB org.

    config MY_INFLUXDB_BUCKET
        string "InfluxDB bucket"
        default "homer1"
        help
            InfluxDB bucket.

    config MY_INFLUXDB_PUSH_DELAY
        int "InfluxDB push delay"
        default 5000
        help
            Delay between each push to InfluxDB.

    config MY_PROMETHEUS_PORT
        int "Prometheus port"
        default 80
        help
            Port to serve prometheus metrics on. Zero to disable.

    config MY_PROMETHEUS_URI
        string "Prometheus URI"
        default "/metrics"
        help
            URI from which Prometheus is accessible.


    config MY_SENSOR_ENABLED_SHT3X
        bool "SHT3X enabled"
        default y
        help
            Whether if SHT3X sensor is enabled or not.

    config MY_SENSOR_ENABLED_S8
        bool "S8 enabled"
        default y
        help
            Whether if S8 sensor is enabled or not.

    config MY_SENSOR_ENABLED_BMP180
        bool "BMP180 enabled"
        default y
        help
            Whether if BMP180 sensor is enabled or not.

    config MY_SENSOR_ENABLED_PMS5003
        bool "PMS5003 enabled"
        default y
        help
            Whether if PMS5003 sensor is enabled or not.

    config MY_PMS5003_TX_PIN
        int "PMS5003 UART TX pin"
        default 25
        help
            UART TX pin connected to PMS5003 sensor.

    config MY_PMS5003_RX_PIN
        int "PMS5003 UART RX pin"
        default 26
        help
            UART RX pin connected to PMS5003 sensor.

    config MY_S8_TX_PIN
        int "S8 UART TX pin"
        default 13
        help
            UART TX pin connected to S8 sensor.

    config MY_S8_RX_PIN
        int "S8 UART RX pin"
        default 27
        help
            UART RX pin connected to S8 sensor.

    config MY_SENSORS_I2C_SDA_PIN
        int "Sensors I2C SDA pin"
        default 33
        help
            I2C SDA pin connected to I2C sensors.

    config MY_SENSORS_I2C_SCL_PIN
        int "Sensors I2C SCL pin"
        default 32
        help
            I2C SCL pin connected to I2C sensors.

    config MY_MEASUREMENT_DELAY_MILLIS
        int "Measurement delay millis"
        default 1000
        help
            How many milliseconds to wait between each sensor measurement.

    config MY_PRINT_DELAY
        int "Print delay"
        default 5000
        help
            Delay between each print to UART, value less than 1 disables printing.

    config MY_ENABLE_WRITE_TO_DISPLAY_ESP
        bool "Enable write to displaying esp"
        default true
        help
            Enable facility to write the sensor read outs to a second esp32 in charge of displaying data

endmenu
```
